## conf/machine/odroidgoa.conf
```bitbake
# Copyright (c) 2019, Fuzhou Rockchip Electronics Co., Ltd
# Released under the MIT license (see COPYING.MIT for the terms)

#@TYPE: Machine
#@NAME: ODROID Go Advance Black Edition

require conf/machine/include/rk3326.inc

KERNEL_DEVICETREE = "rockchip/rk3326-odroidgo2-linux-v11.dtb"

UBOOT_MACHINE = "odroidgoa_defconfig"

RK_WIFIBT_RRECOMMENDS = " \
	brcm-tools \
"
```
